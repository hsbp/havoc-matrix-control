void setup() {
	pinMode(12, OUTPUT);
	pinMode(13, OUTPUT);
	Serial.begin(9600);
}

const uint8_t recB4[] PROGMEM = {0x0, 0x0, 0x0, 0x0, 0x0, 0x0, 0x0, 0x0, 0x0, 0x0, 0x0, 0x0, 0x0,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 0x80, 0x1};
const uint8_t recBM[] PROGMEM = {0x0, 0x0, 0x0, 0x0, 0x0, 0x0, 0x0, 0x0, 0x0, 0x0, 0x0, 0x0, 0x0,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 0x80, 0x1};
const uint8_t recAM[] PROGMEM = {0x0, 0x0, 0x0, 0x0, 0x0, 0x0, 0x0, 0x0, 0x0, 0x0, 0x0, 0x0, 0x0,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 0x80, 0x1};
const uint8_t recAP[] PROGMEM = {0x0, 0x0, 0x0, 0x0, 0x0, 0x0, 0x0, 0x0, 0x0, 0x0, 0x0, 0x0, 0x0,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 0x80, 0x1};
const uint8_t recBP[] PROGMEM = {0x0, 0x0, 0x0, 0x0, 0x0, 0x0, 0x0, 0x0, 0x0, 0x0, 0x0, 0x0, 0x0,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 0x80, 0x3};
const uint8_t recA1[] PROGMEM = {0x0, 0x0, 0x0, 0x0, 0x0, 0x0, 0x0, 0x0, 0x0, 0x0, 0x0, 0x0, 0x0,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 0x80, 0x1};
const uint8_t recA3[] PROGMEM = {0x0, 0x0, 0x0, 0x0, 0x0, 0x0, 0x0, 0x0, 0x0, 0x0, 0x0, 0x0, 0x0,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 0x80, 0x0};
const uint8_t recA2[] PROGMEM = {0x0, 0x0, 0x0, 0x0, 0x0, 0x0, 0x0, 0x0, 0x0, 0x0, 0x0, 0x0, 0x0,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 0xc0, 0x0};
const uint8_t recA4[] PROGMEM = {0x0, 0x0, 0x0, 0x0, 0x0, 0x0, 0x0, 0x0, 0x0, 0x0, 0x0, 0x0, 0x0,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 0x80, 0x0};
const uint8_t recB2[] PROGMEM = {0x0, 0x0, 0x0, 0x0, 0x0, 0x0, 0x0, 0x0, 0x0, 0x0, 0x0, 0x0, 0x0,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 0x80, 0x0};
const uint8_t recB3[] PROGMEM = {0x0, 0x0, 0x0, 0x0, 0x0, 0x0, 0x0, 0x0, 0x0, 0x0, 0x0, 0x0, 0x0,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 0x80, 0x3};
const uint8_t recB1[] PROGMEM = {0x0, 0x0, 0x0, 0x0, 0x0, 0x0, 0x0, 0x0, 0x0, 0x0, 0x0, 0x0, 0x0,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 0x80, 0x1};

void loop() {
	if (!Serial.available()) return;
	uint8_t cmd = Serial.read();

	digitalWrite(13, HIGH);

	uint8_t measurements[255], length;
	const uint8_t *ptr;

	switch (cmd) {
		case 0xA0: length = sizeof(recAM); ptr = recAM; break;
		case 0xA1: length = sizeof(recA1); ptr = recA1; break;
		case 0xA2: length = sizeof(recA2); ptr = recA2; break;
		case 0xA3: length = sizeof(recA3); ptr = recA3; break;
		case 0xA4: length = sizeof(recA4); ptr = recA4; break;
		case 0xA5: length = sizeof(recAP); ptr = recAP; break;
		case 0xB0: length = sizeof(recBM); ptr = recBM; break;
		case 0xB1: length = sizeof(recB1); ptr = recB1; break;
		case 0xB2: length = sizeof(recB2); ptr = recB2; break;
		case 0xB3: length = sizeof(recB3); ptr = recB3; break;
		case 0xB4: length = sizeof(recB4); ptr = recB4; break;
		case 0xB5: length = sizeof(recBP); ptr = recBP; break;
	}

	for (uint8_t octet = 0; octet < length; octet++) {
		measurements[octet] = pgm_read_byte_near(ptr + octet);
	}

	for (uint8_t octet = 0; octet < length; octet++) {
		for (uint8_t b = 128; b != 0; b >>= 1) {
			digitalWrite(12, (measurements[octet] & b) == b ? HIGH : LOW);
			delayMicroseconds(48);
		}
	}

	digitalWrite(13, LOW);
}
